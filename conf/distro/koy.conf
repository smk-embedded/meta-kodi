## conf/distro/koy.conf
```bitbake
require conf/distro/poky.conf

DISTRO = "koy"
DISTRO_NAME = "Kodi On Yocto Distribution"
DISTRO_FEATURES += "systemd"
DISTRO_FEATURES_remove = "x11"

VIRTUAL-RUNTIME_dev_manager = "udev" 
VIRTUAL-RUNTIME_init_manager = "systemd" 
DISTRO_FEATURES_BACKFILL_CONSIDERED += "sysvinit" 
VIRTUAL-RUNTIME_login_manager = "busybox" 
VIRTUAL-RUNTIME_syslog = "" 
VIRTUAL-RUNTIME_initscripts = ""

INHERIT += "image-prelink" 
INHERIT += "image-mklibs"
#QA
INHERIT += "sanity"
INHERIT += "insane"
QA_LOG = "1"
INHERIT += "buildhistory" 
BUILDHISTORY_COMMIT = "1" 
INHERIT += "buildstats"
INHERIT += "recipe_sanity"

# questionable defaults, those might need to be edited
# or overridden by users
LICENSE_FLAGS_WHITELIST = "commercial"
ACCEPT_FSL_EULA = "1"
PREFERRED_PROVIDER_jpeg ?= "libjpeg-turbo" 
PREFERRED_PROVIDER_jpeg-native ?= "libjpeg-turbo-native"
```
